## arch/arm64/configs/tungsten_defconfig
```kconfig
CONFIG_ACCDET_OMTP_CTIA_SWITCH_MANUAL=y
CONFIG_ALS_RAW_SUPPORT=y
CONFIG_AMAZON=y
CONFIG_AMAZON_INPUT_KEYCOMBO=m
CONFIG_AMAZON_SIGN_OF_LIFE=m
CONFIG_AMAZON_TUNGSTEN_FREQ_SCALE=y
CONFIG_AMZN_LD=m
# CONFIG_ARCH_HISI is not set
CONFIG_ARCH_MEDIATEK=y
# CONFIG_ARCH_QCOM is not set
# CONFIG_ARCH_SUNXI is not set
# CONFIG_ARM64_AMU_EXTN is not set
# CONFIG_ARM64_ERRATUM_1165522 is not set
# CONFIG_ARM64_ERRATUM_1542419 is not set
# CONFIG_ARM64_ERRATUM_819472 is not set
# CONFIG_ARM64_ERRATUM_824069 is not set
# CONFIG_ARM64_ERRATUM_826319 is not set
# CONFIG_ARM64_ERRATUM_827319 is not set
# CONFIG_ARM64_ERRATUM_832075 is not set
# CONFIG_ARM64_ERRATUM_843419 is not set
# CONFIG_ARM64_ERRATUM_845719 is not set
# CONFIG_ARM64_ERRATUM_858921 is not set
# CONFIG_ARM64_PTR_AUTH is not set
# CONFIG_ARM64_SSBD is not set
# CONFIG_ARM64_VHE is not set
CONFIG_ARM_DSU_PMU=m
CONFIG_ARM_MEDIATEK_CCI_DEVFREQ=m
CONFIG_ARM_MEDIATEK_CPUFREQ=m
CONFIG_BATTERY_MT6358=m
# CONFIG_BUG_ON_DATA_CORRUPTION is not set
# CONFIG_CAVIUM_ERRATUM_22375 is not set
# CONFIG_CAVIUM_ERRATUM_23154 is not set
# CONFIG_CAVIUM_ERRATUM_27456 is not set
# CONFIG_CAVIUM_ERRATUM_30115 is not set
# CONFIG_CAVIUM_TX2_ERRATUM_219 is not set
# CONFIG_CEC_PLATFORM_DRIVERS is not set
CONFIG_CFI_PERMISSIVE=y
CONFIG_COMMON_CLK_MEDIATEK_DISABLE_UNUSED=m
# CONFIG_COMMON_CLK_MT2712 is not set
# CONFIG_COMMON_CLK_MT6779 is not set
# CONFIG_COMMON_CLK_MT6797 is not set
# CONFIG_COMMON_CLK_MT7622 is not set
CONFIG_COMMON_CLK_MT8169_AUDSYS=y
CONFIG_COMMON_CLK_MT8169_CAMSYS=y
CONFIG_COMMON_CLK_MT8169_IMGSYS=y
CONFIG_COMMON_CLK_MT8169_IMP_IIC_WRAP=y
CONFIG_COMMON_CLK_MT8169_IPESYS=y
CONFIG_COMMON_CLK_MT8169_MDPSYS=y
CONFIG_COMMON_CLK_MT8169_MFGCFG=y
CONFIG_COMMON_CLK_MT8169_MMSYS=y
CONFIG_COMMON_CLK_MT8169_VDECSYS=y
CONFIG_COMMON_CLK_MT8169_VENCSYS=y
CONFIG_COMMON_CLK_MT8169_WPESYS=y
# CONFIG_COMMON_CLK_MT8173 is not set
# CONFIG_COMMON_CLK_MT8183 is not set
# CONFIG_COMMON_CLK_MT8516 is not set
CONFIG_COMMON_CLK_MTK_FREQ_HOPPING=m
CONFIG_CONNECTOR=y
# CONFIG_CPU_FREQ_DEFAULT_GOV_SCHEDUTIL is not set
CONFIG_CPU_FREQ_GOV_USERSPACE=y
CONFIG_CPU_MULTIPLE_CLUSTERS=y
# CONFIG_CRYPTO_BLAKE2B is not set
CONFIG_CRYPTO_CHACHA20POLY1305=y
CONFIG_CRYPTO_XCBC=y
CONFIG_CUSTOM_KERNEL_ACCELEROMETER=y
CONFIG_CUSTOM_KERNEL_ALSPS=y
CONFIG_CUSTOM_KERNEL_IMGSENSOR="hi556_tung_lce_r_mipi_raw hi556_tung_lce_f_mipi_raw hi556_tung_lce3_r_mipi_raw hi556_tung_lce3_f_mipi_raw gc05a2_tung_hlt_r_mipi_raw gc05a2_tung_txd_f_mipi_raw sc520cs_tung_lce_r_mipi_raw sc520cs_tung_lce_f_mipi_raw"
# CONFIG_DEBUG_BUGVERBOSE is not set
CONFIG_DEBUG_CREDENTIALS=y
# CONFIG_DEBUG_INFO is not set
CONFIG_DEBUG_NOTIFIERS=y
CONFIG_DEBUG_SG=y
CONFIG_DEBUG_VIRTUAL=y
CONFIG_DEBUG_WX=y
CONFIG_DEFAULT_MMAP_MIN_ADDR=4096
CONFIG_DRM_FBDEV_EMULATION=y
CONFIG_DRM_MEDIATEK=m
CONFIG_DRM_MEDIATEK_V2=y
CONFIG_DRM_PANEL_BIAS_SUPPORT=m
CONFIG_DRM_PANEL_FT8205_WUXGA_DSI_VDO_TUNGSTEN=m
CONFIG_DRM_PANEL_ILI9882T_WUXGA_DSI_VDO_TUNGSTEN=m
CONFIG_DRM_PANEL_NT36523N_WUXGA_DSI_VDO_TUNGSTEN=m
CONFIG_DYNAMIC_DEBUG=y
CONFIG_EXFAT_FS=y
CONFIG_EXTCON_MTK_USB=m
# CONFIG_FSL_ERRATUM_A008585 is not set
# CONFIG_FUJITSU_ERRATUM_010001 is not set
CONFIG_GENERIC_ADC_THERMAL=m
CONFIG_HAVE_MTK_MC=y
CONFIG_HID_ASUS=y
CONFIG_HID_GFRM=y
CONFIG_HID_ICADE=y
CONFIG_HID_LENOVO=y
CONFIG_HID_PLAYSTATION=y
CONFIG_HID_TIVO=y
CONFIG_HID_TOPSEED=y
CONFIG_HID_TOUCHSCREEN_FTS=m
# CONFIG_HISILICON_ERRATUM_161010101 is not set
# CONFIG_HISILICON_ERRATUM_161600802 is not set
CONFIG_HWMON=y
CONFIG_I2C_CHARDEV=m
CONFIG_I2C_HID=m
CONFIG_I2C_HID_ILITEK=m
CONFIG_I2C_HID_NO_USE_PM=y
CONFIG_I2C_HID_OF=m
CONFIG_I2C_HID_OF_NVT_TS=m
CONFIG_I2C_MT65XX=m
CONFIG_IDME=m
CONFIG_IMGSENSOR_PROJECT="tungsten"
CONFIG_INCREMENTAL_FS=m
CONFIG_INPUT_HALL_BU520=m
CONFIG_INTERCONNECT_MTK=m
CONFIG_INTERCONNECT_MTK_EMI=m
CONFIG_INTERCONNECT_MTK_MMQOS_MT8169=m
# CONFIG_KEYBOARD_ATKBD is not set
CONFIG_KEYBOARD_MTK_KPD=m
CONFIG_KEYBOARD_MTK_PMIC=m
CONFIG_KPD_VOLUME_KEY_SWAP=y
CONFIG_LCD_DUAL_IC_ESD_CHECK=y
CONFIG_LEDS_BL_MTK_PWM=m
# CONFIG_LEDS_CLASS_MULTICOLOR is not set
CONFIG_LEDS_PWM=m
CONFIG_LK_FASTLOGO=y
CONFIG_LOG_BUF_SHIFT=19
CONFIG_MEDIATEK_MT635X_AUXADC=m
CONFIG_MEDIATEK_MT6577_AUXADC=m
CONFIG_MEDIATEK_WATCHDOG=m
CONFIG_MFD_MT6370_PMU=m
CONFIG_MFD_MT6397=y
CONFIG_MMC_BLOCK_MINORS=32
CONFIG_MMC_CQHCI=y
CONFIG_MMC_MTK=m
CONFIG_MMQOS_HRT_RECOUP=m
CONFIG_MT635X_EFUSE=m
CONFIG_MT6370_PMU_BLED=m
CONFIG_MT6370_PMU_CHARGER=m
CONFIG_MT6370_PMU_DSV=m
CONFIG_MT6370_PMU_LDO=m
CONFIG_MTK_AAL_SUPPORT=y
CONFIG_MTK_BOOT=m
CONFIG_MTK_BTIF=m
CONFIG_MTK_CAMERA_ISP_DIP_SUPPORT=m
CONFIG_MTK_CAMERA_ISP_MFB_SUPPORT=m
CONFIG_MTK_CAMERA_ISP_PLATFORM="mt8169"
CONFIG_MTK_CAMERA_ISP_RAW_SUPPORT=m
CONFIG_MTK_CAMERA_ISP_RSC_SUPPORT=m
CONFIG_MTK_CAMERA_ISP_SUPPORT=y
CONFIG_MTK_CAMERA_ISP_WPE_SUPPORT=m
CONFIG_MTK_CAMERA_MEM_SUPPORT=m
CONFIG_MTK_CAM_CAL=m
CONFIG_MTK_CAM_TIMESYNC=m
CONFIG_MTK_CHARGER=m
CONFIG_MTK_CHARGER_THERMAL=m
CONFIG_MTK_CHARGER_TYPE_DETECT=m
CONFIG_MTK_CLKBUF_BBLPM=y
CONFIG_MTK_CLKBUF_NFC=y
CONFIG_MTK_CLK_BUFFER=m
CONFIG_MTK_CMDQ_MBOX_EXT=m
CONFIG_MTK_CM_MGR=m
CONFIG_MTK_CM_MGR_MT8169=m
CONFIG_MTK_COMBO=m
CONFIG_MTK_COMBO_CHIP_CONSYS_8169=y
CONFIG_MTK_COMBO_WIFI=m
CONFIG_MTK_CONNSYS_DEDICATED_LOG_PATH=y
CONFIG_MTK_DEVAPC=m
CONFIG_MTK_DEVINFO=m
CONFIG_MTK_DEVMPU=m
CONFIG_MTK_DRAMC=m
CONFIG_MTK_DVFSRC=m
CONFIG_MTK_DVFSRC_HELPER=m
CONFIG_MTK_DVFSRC_MET_MT6873=m
CONFIG_MTK_EMI=m
CONFIG_MTK_GPU_COMMON_DVFS_SUPPORT=y
CONFIG_MTK_GPU_SUPPORT=m
CONFIG_MTK_GPU_VERSION="mali bifrost r25p0 mt8169"
CONFIG_MTK_HWMON=y
CONFIG_MTK_IMGSENSOR=m
CONFIG_MTK_IMGSENSOR_MT8169="isp6s"
CONFIG_MTK_IOMMU=m
CONFIG_MTK_IOMMU_MISC=m
CONFIG_MTK_IOMMU_MISC_SEC=m
CONFIG_MTK_ION_MM_HEAP=m
CONFIG_MTK_ION_SEC_HEAP=m
CONFIG_MTK_IPI=m
CONFIG_MTK_LAYER_RULE_LOW_LATENCY=y
CONFIG_MTK_LEDS=m
CONFIG_MTK_LTR578=y
CONFIG_MTK_MBOX=m
CONFIG_MTK_MC34XX=y
CONFIG_MTK_MDP=m
CONFIG_MTK_MET_MEM_ALLOC=y
CONFIG_MTK_MMDVFS=m
CONFIG_MTK_PMIC_THERMAL=m
CONFIG_MTK_PMIC_WRAP=m
CONFIG_MTK_QOS_FRAMEWORK=m
CONFIG_MTK_SCPSYS_PM_DOMAINS_DISABLE_UNUSED=m
CONFIG_MTK_SEC_VIDEO_PATH_SUPPORT=y
CONFIG_MTK_SENSOR_SUPPORT=m
CONFIG_MTK_SOC_THERMAL_LVTS=m
CONFIG_MTK_STK8XXX=y
CONFIG_MTK_SVS=m
CONFIG_MTK_TEE_GP_SUPPORT=m
# CONFIG_MTK_THERMAL is not set
CONFIG_MTK_TINYSYS_SSPM_SUPPORT=m
CONFIG_MTK_TINYSYS_SSPM_V2=y
CONFIG_MTK_TRUSTED_MEMORY_SUBSYSTEM=m
CONFIG_MTK_UART_APDMA=m
CONFIG_MTK_USE_AGING_ZCV=y
# CONFIG_MTK_V4L2_IMGSENSOR is not set
CONFIG_NET_ACT_BPF=y
CONFIG_NET_ACT_POLICE=y
CONFIG_NET_CLS_MATCHALL=y
CONFIG_NET_SCH_TBF=y
CONFIG_NL80211_TESTMODE=y
CONFIG_OPTEE=m
CONFIG_OPTEE_NEW_RPC_COMMAND_ID_SET=y
# CONFIG_PCI is not set
CONFIG_PHY_MTK_TPHY=m
# CONFIG_PINCTRL_MT2712 is not set
# CONFIG_PINCTRL_MT6397 is not set
# CONFIG_PINCTRL_MT6765 is not set
# CONFIG_PINCTRL_MT6797 is not set
# CONFIG_PINCTRL_MT7622 is not set
# CONFIG_PINCTRL_MT8173 is not set
# CONFIG_PINCTRL_MT8183 is not set
# CONFIG_PINCTRL_MT8516 is not set
CONFIG_PLAYSTATION_FF=y
CONFIG_PWM_MEDIATEK=m
CONFIG_PWM_MTK_DISP=m
# CONFIG_QCOM_FALKOR_ERRATUM_1003 is not set
# CONFIG_QCOM_FALKOR_ERRATUM_1009 is not set
# CONFIG_QCOM_FALKOR_ERRATUM_E1041 is not set
# CONFIG_QCOM_QDF2400_ERRATUM_0065 is not set
# CONFIG_RANDOM_TRUST_BOOTLOADER is not set
CONFIG_REGULATOR_MT6358=y
CONFIG_REGULATOR_MTK_DVFSRC=m
CONFIG_RESET_ATTACK_MITIGATION=y
CONFIG_RESET_TI_SYSCON=m
CONFIG_RPMSG_MTK=m
CONFIG_RTC_DRV_MT6397=m
CONFIG_SCHED_STACK_END_CHECK=y
CONFIG_SECURITY_DMESG_RESTRICT=y
# CONFIG_SERIAL_8250_DW is not set
CONFIG_SERIAL_8250_MT6577=m
CONFIG_SERIAL_8250_NR_UARTS=2
CONFIG_SERIAL_8250_RUNTIME_UARTS=2
# CONFIG_SLUB_DEBUG is not set
CONFIG_SND_SOC_MEDIATEK=m
CONFIG_SND_SOC_MT6358_ACCDET=m
CONFIG_SND_SOC_MT6366=m
CONFIG_SND_SOC_MT8169=m
CONFIG_SND_SOC_MT8169_TUNGSTEN=m
CONFIG_SND_SOC_MTK_BTCVSD=m
CONFIG_SND_SOC_MTK_SMART_PHONE=m
CONFIG_SND_SOC_MTK_SRAM=m
# CONFIG_SND_SPI is not set
# CONFIG_SOCIONEXT_SYNQUACER_PREITS is not set
CONFIG_SONY_FF=y
# CONFIG_SPECIFY_IMGSENSOR is not set
CONFIG_SPI_MT65XX=m
CONFIG_STYLUS_BATTERY_ALGO=m
CONFIG_SUSPEND_SKIP_SYNC=y
CONFIG_SWITCH=m
CONFIG_SYN_COOKIES=y
CONFIG_SYSCON_REBOOT_MODE=m
CONFIG_SYSRST_COOLING=m
CONFIG_TCPC_CLASS=m
CONFIG_TCPC_MT6370=m
CONFIG_TEE=m
CONFIG_THERMAL_EMERGENCY_POWEROFF_DELAY_MS=100
CONFIG_TP_TO_LCD_ESD_CHECK=y
CONFIG_TRACER_SNAPSHOT=y
CONFIG_TUNGSTEN_SENSOR_OTP=y
CONFIG_USB_MTU3=m
# CONFIG_USB_NET_AQC111 is not set
# CONFIG_USB_NET_CDC_EEM is not set
# CONFIG_USB_NET_CDC_NCM is not set
# CONFIG_USB_RTL8150 is not set
CONFIG_USB_XHCI_HCD=m
CONFIG_USER_BUILD=y
CONFIG_V4L_MEM2MEM_DRIVERS=y
CONFIG_VB2_MEDIATEK_DMA_CONTIG=m
CONFIG_VIDEO_MEDIATEK_HMS=m
CONFIG_VIDEO_MEDIATEK_VCODEC=m
CONFIG_VIDEO_MEDIATEK_VCODEC_PLATFORM="mt8169"
CONFIG_VIDEO_MEDIATEK_VCU_WO_FUSE=y
CONFIG_VIDEO_MTK_AIE=m
CONFIG_VIRTUAL_SENSOR_THERMAL=m
CONFIG_WFD_DYNAMIC_SEC_BUF=y
CONFIG_XFRM_MIGRATE=y
```

## drivers/misc/mediatek/Kconfig
```kconfig
# SPDX-License-Identifier: GPL-2.0

menu "Power, PMIC, Battery & Low Power"
source "drivers/misc/mediatek/clkbuf/Kconfig"
source "drivers/misc/mediatek/cm_mgr/Kconfig"
source "drivers/misc/mediatek/dvfsrc/Kconfig"
source "drivers/misc/mediatek/qos/Kconfig"
source "drivers/misc/mediatek/power_throttling/Kconfig"
source "drivers/misc/mediatek/subpmic/Kconfig"
endmenu # Power

menu "SSPM"
source "drivers/misc/mediatek/sspm/Kconfig"
endmenu # SSPM

menu "MultiMedia, Display, Camera"
config MTK_SEC_VIDEO_PATH_SUPPORT
	bool "Enable MTK Secure Video Path Support"
	default n
	depends on MTK_IN_HOUSE_TEE_SUPPORT || TRUSTONIC_TEE_SUPPORT || \
		MTK_GOOGLE_TRUSTY_SUPPORT || MICROTRUST_TEE_SUPPORT || \
		(TEE)
	help
		This enable MTK Secure Video Path function of Widevine Level1,
		HW protect the online secure video streaming by ARM/Trustzone
		support TEE OS of: Trustonic, Microtrust, Blowfish .etc
		relative modules include: DRM, vdec, venc, cmdq, m4u, display,
		tplay/DXCC,ssvp, secmem, TEE frameworks, keyinstall, DAPC, MPU,
		ION, gralloc,RPMB, DXCC, mediacodec, WFD, MDP.etc
		relative options including: MTK_TEE_SUPPORT, MTK_GP_SUPPORT,
		MTK_DRM_L1_SUPPORT, MTK_PERSIST_PARTITION_SUPPORT,
		MTK_DRM_KEY_MNG_SUPPORT.

config WFD_DYNAMIC_SEC_BUF
	bool "Enable MTK WFD Dynamic Secure Buffer Support"
	default n
	depends on (MTK_IN_HOUSE_TEE_SUPPORT) || (TEE)
	help
		This configure enables Miracast to allocate its secure memory
		by CMA dynamically.

config SVP_DISPLAY_DYNAMIC_SEC_BUF
	bool "Enable MTK SVP Display Dynamic Secure Buffer Support"
	depends on (MTK_IN_HOUSE_TEE_SUPPORT) || (TEE)
	help
		This configure enables SVP display to allocate its secure memory by
		CMA dynamically.

source "drivers/misc/mediatek/iommu/Kconfig"
source "drivers/misc/mediatek/cmdq/Kconfig"
source "drivers/misc/mediatek/mtk-interconnect/Kconfig"
source "drivers/misc/mediatek/mmp/Kconfig"
source "drivers/misc/mediatek/mdp/Kconfig"
source "drivers/misc/mediatek/cam_timesync/Kconfig"
endmenu # MultiMedia, Display, Camera

menu "Security"
config MTK_TEE_GP_SUPPORT
	tristate "Enable MTK GlobalPlatform support in TEE related modules"
	default n
	depends on (TRUSTONIC_TEE_SUPPORT) || (MICROTRUST_TEE_SUPPORT) || \
	           (TEE)
	help
	  GlobalPlatform defines common/consistent APIs and this option
	  enables TEE related modules to use GPAPIs. (depending on
	  Trustonic TEE Support or Microtrust TEE Support or Google Trusty
	  TEE or other 3rd-party TEE)

source "drivers/misc/mediatek/trusted_mem/Kconfig"
source "drivers/misc/mediatek/mtee/Kconfig"
endmenu # Security

menu "Debug, log, trace"
source "drivers/misc/mediatek/boot/Kconfig"
endmenu # Debug

menu "Modem & Connectivity"
source "drivers/misc/mediatek/btif/Kconfig"
source "drivers/misc/mediatek/connectivity/Kconfig"
endmenu # Modem

menu "Other Peripherals"
source "drivers/misc/mediatek/rt-regmap/Kconfig"
source "drivers/misc/mediatek/typec/Kconfig"
source "drivers/misc/mediatek/extcon/Kconfig"
source "drivers/misc/mediatek/sensors-1.0/Kconfig"
source "drivers/misc/mediatek/leds/Kconfig"
endmenu # Other Peripheral
```

## drivers/staging/amazon/Kconfig
```kconfig
menu "Amazon"

config AMAZON
	bool "Amazon Drivers"
	default N
	help
	  Enable support for various drivers needed on the Amazon Fire OS platform

if AMAZON

config USER_BUILD
	bool "USER_BUILD"
	default n
	help
	  Indicate if user build

config AMAZON_SIGN_OF_LIFE
	tristate "Amazon Sign of Life"
	help
	  enable the life cycle metrics to log device boot and shutdown information

config AMAZON_POWEROFF_LOG
	bool "Long press key power off log"
	default N
	help
	  enable Long press key power off log

endif #if AMAZON

endmenu
```

## drivers/thermal/mediatek/Kconfig
```kconfig
# SPDX-License-Identifier: GPL-2.0-only
config MTK_SOC_THERMAL_LVTS
        tristate "LVTS (Low voltage thermal sensor) driver for Mediatek SoCs"
        depends on HAS_IOMEM
        depends on NVMEM
        depends on RESET_TI_SYSCON
        help
          Enable this option if you want to get SoC temperature
          information for Mediatek platforms. This driver
          configures LVTS thermal controllers to collect temperatures
          via Analog Serial Interface(ASIF).

config MTK_PMIC_THERMAL
	tristate "PMIC thermal sensor driver for Mediatek SoCs"
	depends on MT635X_EFUSE || MT6359_EFUSE
	depends on MEDIATEK_MT635X_AUXADC
	help
	  Enable this option if you want to get PMIC temperature
	  for Mediatek platforms.
	  This driver reads the voltage value from PMIC AUXADC channels,
	  and converts raw value to PMIC temperature via PMIC efuse data.
```
