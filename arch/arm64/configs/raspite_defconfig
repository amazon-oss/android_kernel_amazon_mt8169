## arch/arm64/configs/raspite_defconfig
```kconfig
CONFIG_ACCDET_OMTP_CTIA_SWITCH_MANUAL=y
CONFIG_AMAZON=y
CONFIG_AMAZON_INPUT_KEYCOMBO=m
CONFIG_AMAZON_SIGN_OF_LIFE=m
CONFIG_AMZN_LD=m
# CONFIG_ARCH_HISI is not set
CONFIG_ARCH_MEDIATEK=y
# CONFIG_ARCH_QCOM is not set
# CONFIG_ARCH_SUNXI is not set
# CONFIG_ARM64_AMU_EXTN is not set
# CONFIG_ARM64_ERRATUM_1165522 is not set
# CONFIG_ARM64_ERRATUM_1286807 is not set
# CONFIG_ARM64_ERRATUM_1418040 is not set
# CONFIG_ARM64_ERRATUM_1463225 is not set
# CONFIG_ARM64_ERRATUM_1542419 is not set
# CONFIG_ARM64_ERRATUM_819472 is not set
# CONFIG_ARM64_ERRATUM_824069 is not set
# CONFIG_ARM64_ERRATUM_826319 is not set
# CONFIG_ARM64_ERRATUM_827319 is not set
# CONFIG_ARM64_ERRATUM_832075 is not set
# CONFIG_ARM64_ERRATUM_843419 is not set
# CONFIG_ARM64_ERRATUM_845719 is not set
# CONFIG_ARM64_ERRATUM_858921 is not set
# CONFIG_ARM64_PTR_AUTH is not set
# CONFIG_ARM64_SSBD is not set
# CONFIG_ARM64_VHE is not set
CONFIG_ARM_DSU_PMU=m
CONFIG_ARM_MEDIATEK_CCI_DEVFREQ=m
CONFIG_ARM_MEDIATEK_CPUFREQ=m
CONFIG_BATTERY_MT6357=m
# CONFIG_BUG_ON_DATA_CORRUPTION is not set
# CONFIG_CAVIUM_ERRATUM_22375 is not set
# CONFIG_CAVIUM_ERRATUM_23154 is not set
# CONFIG_CAVIUM_ERRATUM_27456 is not set
# CONFIG_CAVIUM_ERRATUM_30115 is not set
# CONFIG_CAVIUM_TX2_ERRATUM_219 is not set
# CONFIG_CEC_PLATFORM_DRIVERS is not set
CONFIG_CFI_PERMISSIVE=y
CONFIG_COMMON_CLK_MEDIATEK_DISABLE_UNUSED=m
# CONFIG_COMMON_CLK_MT2712 is not set
# CONFIG_COMMON_CLK_MT6779 is not set
# CONFIG_COMMON_CLK_MT6797 is not set
# CONFIG_COMMON_CLK_MT7622 is not set
CONFIG_COMMON_CLK_MT8169_AUDSYS=y
CONFIG_COMMON_CLK_MT8169_CAMSYS=y
CONFIG_COMMON_CLK_MT8169_IMGSYS=y
CONFIG_COMMON_CLK_MT8169_IMP_IIC_WRAP=y
CONFIG_COMMON_CLK_MT8169_IPESYS=y
CONFIG_COMMON_CLK_MT8169_MDPSYS=y
CONFIG_COMMON_CLK_MT8169_MFGCFG=y
CONFIG_COMMON_CLK_MT8169_MMSYS=y
CONFIG_COMMON_CLK_MT8169_VDECSYS=y
CONFIG_COMMON_CLK_MT8169_VENCSYS=y
CONFIG_COMMON_CLK_MT8169_WPESYS=y
# CONFIG_COMMON_CLK_MT8173 is not set
# CONFIG_COMMON_CLK_MT8183 is not set
# CONFIG_COMMON_CLK_MT8516 is not set
CONFIG_COMMON_CLK_MTK_FREQ_HOPPING=m
CONFIG_CONNECTOR=y
CONFIG_CPU_FREQ_GOV_USERSPACE=y
# CONFIG_CRYPTO_BLAKE2B is not set
CONFIG_CRYPTO_CHACHA20POLY1305=y
CONFIG_CRYPTO_XCBC=y
CONFIG_CUSTOM_KERNEL_ACCELEROMETER=y
CONFIG_CUSTOM_KERNEL_ALSPS=y
CONFIG_CUSTOM_KERNEL_IMGSENSOR="gc02m1_raspite_raw_cxt_rear ov02b10_raspite_raw_cxt_front gc02m1_raspite_raw_jk_rear gc02m1_raspite_raw_jk_front ov02b10_raspite_raw_sjc_rear ov02b10_raspite_raw_sjc_front gc5035_raspite_raw_lce_rear hi556_raspite_raw_hlt_rear sc202cs_raspite_raw_lce_rear gc02m3_raspite_raw_lce_front sc520cs_raspite_raw_lce_rear gc05a2_raspite_raw_txd_rear"
# CONFIG_DEBUG_BUGVERBOSE is not set
# CONFIG_DEBUG_INFO is not set
CONFIG_DEFAULT_MMAP_MIN_ADDR=4096
CONFIG_DRM_FBDEV_EMULATION=y
CONFIG_DRM_MEDIATEK=m
CONFIG_DRM_MEDIATEK_V2=y
CONFIG_DRM_PANEL_ER88577B_WXGA_DSI_VDO_RASPITE=m
CONFIG_DRM_PANEL_ILI9881C_WXGA_DSI_VDO_RASPITE=m
CONFIG_DRM_PANEL_ST7705_WXGA_DSI_VDO_RASPITE=m
CONFIG_DYNAMIC_DEBUG=y
CONFIG_EXFAT_FS=y
CONFIG_EXTCON_MTK_USB=m
# CONFIG_FSL_ERRATUM_A008585 is not set
# CONFIG_FUJITSU_ERRATUM_010001 is not set
CONFIG_FUSB251=m
CONFIG_GENERIC_ADC_THERMAL=m
# CONFIG_HARDEN_BRANCH_PREDICTOR is not set
# CONFIG_HARDEN_EL2_VECTORS is not set
CONFIG_HAVE_MTK_MC=y
CONFIG_HID_ASUS=y
CONFIG_HID_GFRM=y
CONFIG_HID_ICADE=y
CONFIG_HID_KYE=y
CONFIG_HID_LENOVO=y
CONFIG_HID_PLAYSTATION=y
CONFIG_HID_TIVO=y
CONFIG_HID_TOPSEED=y
# CONFIG_HISILICON_ERRATUM_161010101 is not set
# CONFIG_HISILICON_ERRATUM_161600802 is not set
CONFIG_HWMON=y
CONFIG_I2C_CHARDEV=m
CONFIG_I2C_HID=m
CONFIG_I2C_MT65XX=m
CONFIG_IDME=m
CONFIG_IMGSENSOR_PROJECT="raspite"
CONFIG_INCREMENTAL_FS=m
CONFIG_INPUT_HALL_BU520=m
CONFIG_INTERCONNECT_MTK=m
CONFIG_INTERCONNECT_MTK_EMI=m
CONFIG_INTERCONNECT_MTK_MMQOS_MT8169=m
# CONFIG_KEYBOARD_ATKBD is not set
CONFIG_KEYBOARD_MTK_KPD=m
CONFIG_KEYBOARD_MTK_PMIC=m
CONFIG_KPD_VOLUME_KEY_SWAP=y
CONFIG_LEDS_BL_MTK_PWM=m
# CONFIG_LEDS_CLASS_MULTICOLOR is not set
CONFIG_LEDS_PWM=m
CONFIG_LK_FASTLOGO=y
CONFIG_LOG_BUF_SHIFT=19
CONFIG_MAX20342=m
CONFIG_MEDIATEK_MT635X_AUXADC=m
CONFIG_MEDIATEK_MT6577_AUXADC=m
CONFIG_MEDIATEK_WATCHDOG=m
CONFIG_MFD_MT6370_PMU=m
CONFIG_MFD_MT6397=y
CONFIG_MMC_BLOCK_MINORS=32
CONFIG_MMC_CQHCI=y
CONFIG_MMC_MTK=m
CONFIG_MT635X_EFUSE=m
CONFIG_MT6370_PMU_BLED=m
CONFIG_MT6370_PMU_CHARGER=m
CONFIG_MT6370_PMU_DSV=m
CONFIG_MT6370_PMU_LDO=m
CONFIG_MTK_AAL_SUPPORT=y
CONFIG_MTK_BOOT=m
CONFIG_MTK_BTIF=m
CONFIG_MTK_CAMERA_ISP_DIP_SUPPORT=m
CONFIG_MTK_CAMERA_ISP_MFB_SUPPORT=m
CONFIG_MTK_CAMERA_ISP_PLATFORM="mt8169"
CONFIG_MTK_CAMERA_ISP_RAW_SUPPORT=m
CONFIG_MTK_CAMERA_ISP_RSC_SUPPORT=m
CONFIG_MTK_CAMERA_ISP_SUPPORT=y
CONFIG_MTK_CAMERA_ISP_WPE_SUPPORT=m
CONFIG_MTK_CAMERA_MEM_SUPPORT=m
CONFIG_MTK_CAM_CAL=m
CONFIG_MTK_CAM_TIMESYNC=m
CONFIG_MTK_CHARGER=m
CONFIG_MTK_CHARGER_THERMAL=m
CONFIG_MTK_CHARGER_TYPE_DETECT=m
CONFIG_MTK_CLKBUF_BBLPM=y
CONFIG_MTK_CLKBUF_NFC=y
CONFIG_MTK_CLK_BUFFER=m
CONFIG_MTK_CMDQ_MBOX_EXT=m
CONFIG_MTK_CM_MGR=m
CONFIG_MTK_CM_MGR_MT8169=m
CONFIG_MTK_COMBO=m
CONFIG_MTK_COMBO_CHIP_CONSYS_8169=y
CONFIG_MTK_COMBO_WIFI=m
CONFIG_MTK_CONNSYS_DEDICATED_LOG_PATH=y
CONFIG_MTK_DEVAPC=m
CONFIG_MTK_DEVINFO=m
CONFIG_MTK_DEVMPU=m
CONFIG_MTK_DRAMC=m
CONFIG_MTK_DVFSRC=m
CONFIG_MTK_DVFSRC_HELPER=m
CONFIG_MTK_DVFSRC_MET_MT6873=m
CONFIG_MTK_EMI=m
CONFIG_MTK_GPU_COMMON_DVFS_SUPPORT=y
CONFIG_MTK_GPU_SUPPORT=m
CONFIG_MTK_GPU_VERSION="mali bifrost r25p0 mt8169"
CONFIG_MTK_HWMON=y
CONFIG_MTK_IMGSENSOR=m
CONFIG_MTK_IMGSENSOR_MT8169="isp6s"
CONFIG_MTK_IOMMU=m
CONFIG_MTK_IOMMU_MISC=m
CONFIG_MTK_IOMMU_MISC_SEC=m
CONFIG_MTK_ION_MM_HEAP=m
CONFIG_MTK_ION_SEC_HEAP=m
CONFIG_MTK_IPI=m
CONFIG_MTK_LEDS=m
CONFIG_MTK_LTR578=y
CONFIG_MTK_MBOX=m
CONFIG_MTK_MC34XX=y
CONFIG_MTK_MDP=m
CONFIG_MTK_MET_MEM_ALLOC=y
CONFIG_MTK_MMDVFS=m
CONFIG_MTK_PMIC_THERMAL=m
CONFIG_MTK_PMIC_WRAP=y
CONFIG_MTK_QOS_FRAMEWORK=m
CONFIG_MTK_SCPSYS_PM_DOMAINS_DISABLE_UNUSED=m
CONFIG_MTK_SEC_VIDEO_PATH_SUPPORT=y
CONFIG_MTK_SENSOR_SUPPORT=m
CONFIG_MTK_SOC_THERMAL_LVTS=m
CONFIG_MTK_STK8XXX=y
CONFIG_MTK_SVS=m
CONFIG_MTK_TEE_GP_SUPPORT=m
# CONFIG_MTK_THERMAL is not set
CONFIG_MTK_TINYSYS_SSPM_SUPPORT=m
CONFIG_MTK_TINYSYS_SSPM_V2=y
CONFIG_MTK_TRUSTED_MEMORY_SUBSYSTEM=m
CONFIG_MTK_UART_APDMA=m
CONFIG_MTK_USE_AGING_ZCV=y
CONFIG_NETFILTER_NETLINK_ACCT=y
CONFIG_NET_ACT_BPF=y
CONFIG_NET_ACT_POLICE=y
CONFIG_NET_CLS_MATCHALL=y
CONFIG_NET_SCH_TBF=y
CONFIG_NF_CONNTRACK_TIMESTAMP=y
CONFIG_NL80211_TESTMODE=y
CONFIG_OPTEE=m
# CONFIG_PCI is not set
CONFIG_PHY_MTK_TPHY=m
# CONFIG_PINCTRL_MT2712 is not set
# CONFIG_PINCTRL_MT6397 is not set
# CONFIG_PINCTRL_MT6765 is not set
# CONFIG_PINCTRL_MT6797 is not set
# CONFIG_PINCTRL_MT7622 is not set
# CONFIG_PINCTRL_MT8173 is not set
# CONFIG_PINCTRL_MT8183 is not set
# CONFIG_PINCTRL_MT8516 is not set
CONFIG_PLAYSTATION_FF=y
CONFIG_PMIC_LBAT_SERVICE=m
CONFIG_PUBADC_MANAGE=m
CONFIG_PWM_MEDIATEK=m
CONFIG_PWM_MTK_DISP=m
# CONFIG_QCOM_FALKOR_ERRATUM_1003 is not set
# CONFIG_QCOM_FALKOR_ERRATUM_1009 is not set
# CONFIG_QCOM_FALKOR_ERRATUM_E1041 is not set
# CONFIG_QCOM_QDF2400_ERRATUM_0065 is not set
# CONFIG_RANDOM_TRUST_BOOTLOADER is not set
CONFIG_REGULATOR_MA5150=m
CONFIG_REGULATOR_MT6357=y
CONFIG_REGULATOR_MTK_DVFSRC=m
CONFIG_RESET_TI_SYSCON=m
CONFIG_RPMSG_MTK=m
CONFIG_RTC_DRV_MT6397=m
CONFIG_SECURITY_DMESG_RESTRICT=y
# CONFIG_SERIAL_8250_DW is not set
CONFIG_SERIAL_8250_MT6577=m
CONFIG_SERIAL_8250_NR_UARTS=2
CONFIG_SERIAL_8250_RUNTIME_UARTS=2
# CONFIG_SLUB_DEBUG is not set
CONFIG_SND_SOC_AW87XXX=m
CONFIG_SND_SOC_DC_DETECTION_SUPPORT=y
CONFIG_SND_SOC_MT8169_RASPITE=m
CONFIG_SND_SOC_MTK_BTCVSD=m
# CONFIG_SND_SPI is not set
# CONFIG_SOCIONEXT_SYNQUACER_PREITS is not set
CONFIG_SONY_FF=y
CONFIG_SPI_MT65XX=m
CONFIG_SUSPEND_SKIP_SYNC=y
CONFIG_SVP_DISPLAY_DYNAMIC_SEC_BUF=y
CONFIG_SWITCH=m
CONFIG_SYN_COOKIES=y
CONFIG_SYSCON_REBOOT_MODE=m
CONFIG_SYSRST_COOLING=m
CONFIG_TCPC_CLASS=m
CONFIG_TCPC_MT6370=m
CONFIG_TEE=m
CONFIG_THERMAL_DEFAULT_GOV_POWER_ALLOCATOR=y
CONFIG_THERMAL_EMERGENCY_POWEROFF_DELAY_MS=100
CONFIG_THERMAL_FOD=y
CONFIG_TOUCHSCREEN_GOODIX_BRL=m
CONFIG_TOUCHSCREEN_GT9XX=m
CONFIG_TRACER_SNAPSHOT=y
# CONFIG_UNMAP_KERNEL_AT_EL0 is not set
CONFIG_USB_MTU3=m
# CONFIG_USB_NET_AQC111 is not set
# CONFIG_USB_NET_CDC_EEM is not set
# CONFIG_USB_NET_CDC_NCM is not set
# CONFIG_USB_RTL8150 is not set
CONFIG_USB_XHCI_HCD=m
CONFIG_USER_BUILD=y
CONFIG_V4L_MEM2MEM_DRIVERS=y
CONFIG_VB2_MEDIATEK_DMA_CONTIG=m
CONFIG_VIDEO_MEDIATEK_HMS=m
CONFIG_VIDEO_MEDIATEK_VCODEC=m
CONFIG_VIDEO_MEDIATEK_VCODEC_PLATFORM="mt8169"
CONFIG_VIDEO_MEDIATEK_VCU_WO_FUSE=y
CONFIG_VIDEO_MTK_AIE=m
CONFIG_VIRTUAL_SENSOR_THERMAL=m
CONFIG_WFD_DYNAMIC_SEC_BUF=y
CONFIG_WPC_IDTP922X=m
```
