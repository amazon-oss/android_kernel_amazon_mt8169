// SPDX-License-Identifier: GPL-2.0
/*
 * Copyright (c) 2023 Amazon.com, Inc. or its affiliates. All Rights Reserved.
 */

/dts-v1/;
/plugin/;

#define TUNGSTEN_PROTO
#include "tungsten.dtsi"

&chosen {
	version = "proto";
};
